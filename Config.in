## Config.in
```kconfig
menu "atv329q board packages"

source "$BR2_EXTERNAL_ATV329Q_PATH/package/atv329q-screen/Config.in"
source "$BR2_EXTERNAL_ATV329Q_PATH/package/docker-bin/Config.in"

endmenu
```

## package/atv329q-screen/Config.in
```kconfig
config BR2_PACKAGE_ATV329Q_SCREEN
	bool "atv329q display (MDP3 -> DSI -> ADV7533 HDMI)"
	default y
	help
	  Display support for the atv329q: the kernel side (DRM/KMS with fbdev
	  emulation, framebuffer console, boot logo -- all already enabled in
	  board/geniatech/atv329q/linux.config) plus the userland side:

	    - /etc/init.d/S15screen, the oracle-gated DPMS re-arm helper (it
	      reads the ADV7533 lock oracle with busybox's i2cget applet),
	    - a getty on tty0, i.e. a login prompt on the HDMI screen.

	  Disable for a headless box: the package then merges its
	  linux-noscreen.config kernel fragment, which drops DRM/FB/fbcon/logo
	  from the kernel, and installs none of the userland. Access stays over
	  SSH (eth0/wlan0) and the serial console.

	  The kernel patches (MDP3 driver, DSI, ADV7533, MDSS clock, device
	  tree) are always applied -- they are the board's source of truth.
	  This only controls whether the display is built and used.

	  Note: the kernel differs between on and off, so run
	  `./build.sh kernel` after flipping this.
```

## package/docker-bin/Config.in
```kconfig
config BR2_PACKAGE_DOCKER_BIN
	bool "docker-bin (official static armhf binaries)"
	depends on BR2_arm
	default y
	select BR2_PACKAGE_IPTABLES         # container NAT / port publishing
	select BR2_PACKAGE_CA_CERTIFICATES  # pull images over HTTPS
	select BR2_PACKAGE_CGROUPFS_MOUNT   # mounts the cgroup hierarchy (S30cgroupfs)
	select BR2_PACKAGE_IPROUTE2         # `ip`, for container networking
	help
	  Install Docker from the official prebuilt STATIC binaries for armhf
	  (dockerd, docker, containerd, runc, ...). They are statically linked
	  (no libc dependency), so no Go cross-toolchain is compiled -- unlike
	  the Buildroot docker-engine package, this builds on any host arch.

	  The kernel side comes with the package: enabling it merges
	  linux-docker.config (namespaces, cgroups incl. the v1 memory/cpuset
	  controllers, overlayfs, bridge/veth/vxlan, netfilter NAT) on top of
	  linux.config, so the engine and the kernel can't drift apart.

	  Note: the kernel differs between on and off, so run
	  `./build.sh kernel` after flipping this.

	  https://docs.docker.com/engine/install/binaries/
```
